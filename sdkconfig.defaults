## sdkconfig.defaults
```kconfig
# BLE
CONFIG_BT_ENABLED=y
CONFIG_BT_BLUEDROID_ENABLED=y
CONFIG_BT_BLE_ENABLED=y
CONFIG_BT_CLASSIC_ENABLED=n
CONFIG_BT_BLE_42_FEATURES_SUPPORTED=y

# GATT
CONFIG_GATTS_ENABLE=y
CONFIG_GATTC_ENABLE=n

# Flash / NVS
CONFIG_NVS_ENCRYPTION=n
CONFIG_ESPTOOLPY_FLASHSIZE_4MB=y

# FreeRTOS
CONFIG_FREERTOS_HZ=1000

# Logging
CONFIG_LOG_DEFAULT_LEVEL_INFO=y

# LEDC (PWM for servos)
CONFIG_LEDC_TIMER_RESOLUTION_BITS=14
```
